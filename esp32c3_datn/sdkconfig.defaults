## esp32c3_datn/sdkconfig.defaults
```kconfig
# ── Target ────────────────────────────────────────────────────────────────────
CONFIG_IDF_TARGET="esp32c3"

# ── CPU ───────────────────────────────────────────────────────────────────────
CONFIG_ESP32C3_DEFAULT_CPU_FREQ_MHZ_160=y

# ── FreeRTOS ──────────────────────────────────────────────────────────────────
CONFIG_FREERTOS_HZ=1000

# ── Logging ───────────────────────────────────────────────────────────────────
CONFIG_LOG_DEFAULT_LEVEL_INFO=y
CONFIG_LOG_MAXIMUM_LEVEL_DEBUG=y

# ── Bluetooth (disabled to save RAM/flash) ────────────────────────────────────
CONFIG_BT_ENABLED=n

# ── WiFi ──────────────────────────────────────────────────────────────────────
# Disable AP mode – STA only
CONFIG_ESP_WIFI_SOFTAP_SUPPORT=n

# ── FAT / SD card ─────────────────────────────────────────────────────────────
CONFIG_FATFS_LFN_HEAP=y
CONFIG_FATFS_MAX_LFN=255

# ── Partition Table ───────────────────────────────────────────────────────────
# Binary > 1 MB → use single-app-large partition (1.5 MB factory slot)
CONFIG_PARTITION_TABLE_SINGLE_APP_LARGE=y

# ── Watchdog ──────────────────────────────────────────────────────────────────
# DS18B20 conversion takes 750 ms + HTTP timeout 5 s → give plenty of margin
CONFIG_ESP_TASK_WDT_TIMEOUT_S=60

# ── SNTP ──────────────────────────────────────────────────────────────────────
CONFIG_LWIP_DHCP_GET_NTP_SRV=y

# ── LibC – GCC 15.1.0 toolchain ships picolibc instead of newlib ─────────────
CONFIG_IDF_EXPERIMENTAL_FEATURES=y
CONFIG_LIBC_PICOLIBC=y
```
